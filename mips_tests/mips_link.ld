/*
 * =================================================================
 *  Файл: mips_link.ld (ФИНАЛЬНАЯ УНИФИЦИРОВАННАЯ ВЕРСИЯ)
 * =================================================================
 *  - Определяет стандартный адрес завершения теста SCR1_SIM_EXIT_ADDR.
 *  - Ассемблер может использовать этот символ для перехода.
 */
ENTRY(_start_physical)

/* Определяем глобальный символ для стандартного адреса выхода SCR1 */
SCR1_SIM_EXIT_ADDR = 0xF4;

SECTIONS
{
    .text :
    {
        * (.text)
    }
}